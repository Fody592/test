// ESP32-S3: hosts the app (http, port 80) + WebSocket control (port 81) over Wi-Fi.
// Libraries: "WebSockets" by Markus Sattler, "ArduinoJson" 7.x. (WiFi/WebServer/ESPmDNS are built in.)
// Open http://drink.local (or the IP in Serial Monitor) on your phone, same Wi-Fi.
#include <WiFi.h>
#include <WebServer.h>
#include <ESPmDNS.h>
#include <WebSocketsServer.h>
#include <ArduinoJson.h>
#include "index_html.h"   // generated by `npm run build:esp` (the app itself)

const char* WIFI_SSID = "YOUR_WIFI_NAME";      // <-- change
const char* WIFI_PASS = "YOUR_WIFI_PASSWORD";  // <-- change

#define NUM_PUMPS 19
// TODO: set to your driver GPIOs (avoid strapping/USB/flash pins).
const int PUMP_PINS[NUM_PUMPS] = {1,2,4,5,6,7,15,16,17,18,8,9,10,11,12,13,14,38,39};
const int WATER_PIN = 40;

WebServer http(80);
WebSocketsServer ws(81);

uint32_t pumpOffAt[NUM_PUMPS];
uint32_t waterMs = 0, waterOffAt = 0;
enum { IDLE, POURING, RINSING } phase = IDLE;

void notify(const char* json) { ws.broadcastTXT(json); }
void allOff() { for (int i = 0; i < NUM_PUMPS; i++) digitalWrite(PUMP_PINS[i], LOW); digitalWrite(WATER_PIN, LOW); }

void handleCommand(const String& line) {
  JsonDocument doc;
  if (deserializeJson(doc, line)) { notify("{\"status\":\"ERROR\",\"message\":\"bad json\"}"); return; }
  if (phase != IDLE) { notify("{\"status\":\"ERROR\",\"message\":\"busy\"}"); return; }

  const char* cmd = doc["command"] | "";
  if (strcmp(cmd, "DISPENSE") && strcmp(cmd, "FLUSH")) { notify("{\"status\":\"ERROR\",\"message\":\"unknown command\"}"); return; }

  uint32_t now = millis(), longest = 0;
  for (JsonObject p : doc["pumps"].as<JsonArray>()) {
    int id = p["id"] | 0; uint32_t t = p["time_ms"] | 0;
    if (id < 1 || id > NUM_PUMPS || t == 0 || t > 15000) continue;   // safety clamp
    pumpOffAt[id - 1] = now + t;
    digitalWrite(PUMP_PINS[id - 1], HIGH);
    if (t > longest) longest = t;
  }
  waterMs = min<uint32_t>(doc["flush_water_ms"] | 0, 30000);
  phase = POURING;
  if (longest == 0) { phase = RINSING; waterOffAt = now + waterMs; digitalWrite(WATER_PIN, waterMs ? HIGH : LOW); }
}

void onWs(uint8_t num, WStype_t type, uint8_t* payload, size_t len) {
  if (type == WStype_TEXT) handleCommand(String((char*)payload).substring(0, len));
  // Fail-safe: nobody connected -> stop everything
  if (type == WStype_DISCONNECTED && ws.connectedClients() == 0) { allOff(); phase = IDLE; }
}

void setup() {
  Serial.begin(115200);
  for (int i = 0; i < NUM_PUMPS; i++) pinMode(PUMP_PINS[i], OUTPUT);
  pinMode(WATER_PIN, OUTPUT);
  allOff();

  WiFi.mode(WIFI_STA);
  WiFi.begin(WIFI_SSID, WIFI_PASS);
  for (int i = 0; i < 30 && WiFi.status() != WL_CONNECTED; i++) delay(500);
  if (WiFi.status() == WL_CONNECTED) {
    Serial.print("Open http://drink.local  or  http://"); Serial.println(WiFi.localIP());
  } else {                                   // fallback: own hotspot (phone has no internet -> no Gemini)
    WiFi.mode(WIFI_AP);
    WiFi.softAP("DRINK-DISPENSER", "dispenser123");
    Serial.print("Hotspot DRINK-DISPENSER (pw dispenser123): http://"); Serial.println(WiFi.softAPIP());
  }
  MDNS.begin("drink");

  http.on("/", []() {
    http.sendHeader("Content-Encoding", "gzip");
    http.send_P(200, "text/html", (const char*)INDEX_HTML_GZ, INDEX_HTML_GZ_LEN);
  });
  http.onNotFound([]() { http.sendHeader("Location", "/"); http.send(302); });
  http.begin();
  ws.begin();
  ws.onEvent(onWs);
}

void loop() {
  http.handleClient();
  ws.loop();

  uint32_t now = millis();
  if (phase == POURING) {
    bool any = false;
    for (int i = 0; i < NUM_PUMPS; i++) {
      if (pumpOffAt[i] && now >= pumpOffAt[i]) { digitalWrite(PUMP_PINS[i], LOW); pumpOffAt[i] = 0; }
      if (pumpOffAt[i]) any = true;
    }
    if (!any) {
      if (waterMs) { phase = RINSING; waterOffAt = now + waterMs; digitalWrite(WATER_PIN, HIGH); }
      else { phase = IDLE; notify("{\"status\":\"DONE\"}"); }
    }
  } else if (phase == RINSING && now >= waterOffAt) {
    digitalWrite(WATER_PIN, LOW); phase = IDLE; notify("{\"status\":\"DONE\"}");
  }
}
